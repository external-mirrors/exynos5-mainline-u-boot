// SPDX-License-Identifier: GPL-2.0+
/*
 * Samsung's Exynos5420 Galaxy Note Pro 12.2 WiFi board device tree source
 *
 * Copyright (c) 2025 Hendrik Noack
 */

/dts-v1/;
#include "exynos5420-galaxy-tab-common.dtsi"

/ {
	model = "Samsung Galaxy Note Pro 12.2 WiFi based on Exynos5420";
	compatible = "samsung,v1a-wifi", "samsung,exynos5420", \
			"samsung,exynos5";
};
