// SPDX-License-Identifier: GPL-2.0+
/*
 * Samsung's Exynos5420 Chagall WiFi board device tree source
 *
 * Copyright (c) 2026 Hendrik Noack
 */

/dts-v1/;
#include "exynos5420-galaxy-tab-common.dtsi"

/ {
	model = "Samsung Chagall WiFi based on Exynos5420";
	compatible = "samsung,chagall-wifi", "samsung,exynos5420", \
		     "samsung,exynos5";
};
