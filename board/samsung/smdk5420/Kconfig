## board/samsung/smdk5420/Kconfig
```kconfig
if TARGET_N1AWIFI

config ENV_SOURCE_FILE
	default "galaxy-tab-pro"

config SYS_BOARD
	default "smdk5420"

config SYS_VENDOR
	default "samsung"

config SYS_CONFIG_NAME
	default "n1awifi"

endif

if TARGET_N2AWIFI

config ENV_SOURCE_FILE
	default "galaxy-tab-pro"

config SYS_BOARD
	default "smdk5420"

config SYS_VENDOR
	default "samsung"

config SYS_CONFIG_NAME
	default "n2awifi"

endif

if TARGET_ODROID_XU3

config SYS_BOARD
	default "odroid"

config SYS_VENDOR
	default "samsung"

config SYS_CONFIG_NAME
	default "odroid_xu3"

endif

if TARGET_PEACH_PI

config SYS_BOARD
	default "smdk5420"

config SYS_VENDOR
	default "samsung"

config SYS_CONFIG_NAME
	default "peach-pi"

endif

if TARGET_PEACH_PIT

config SYS_BOARD
	default "smdk5420"

config SYS_VENDOR
	default "samsung"

config SYS_CONFIG_NAME
	default "peach-pit"

endif

if TARGET_SMDK5420

config SYS_BOARD
	default "smdk5420"

config SYS_VENDOR
	default "samsung"

config SYS_CONFIG_NAME
	default "smdk5420"

endif

if TARGET_V1A_WIFI

config ENV_SOURCE_FILE
	default "galaxy-tab-pro"

config SYS_BOARD
	default "smdk5420"

config SYS_VENDOR
	default "samsung"

config SYS_CONFIG_NAME
	default "v1a_wifi"

endif
```

## configs/n2awifi_defconfig
```kconfig
CONFIG_ARM=y
CONFIG_ARCH_CPU_INIT=y
CONFIG_ARCH_EXYNOS=y
CONFIG_TEXT_BASE=0x20008000
CONFIG_SYS_MALLOC_LEN=0x5004000
CONFIG_SYS_MALLOC_F_LEN=0x400
CONFIG_ARCH_EXYNOS5=y
CONFIG_TARGET_N2AWIFI=y
CONFIG_NR_DRAM_BANKS=4
CONFIG_SF_DEFAULT_SPEED=50000000
CONFIG_ENV_SIZE=0x4000
CONFIG_DEFAULT_DEVICE_TREE="exynos5420-n2awifi"
CONFIG_SYS_LOAD_ADDR=0x20008000
CONFIG_IDENT_STRING=" for n2awifi"
CONFIG_SYS_MEM_TOP_HIDE=0x600000
# CONFIG_EFI_GRUB_ARM32_WORKAROUND is not set
CONFIG_BUTTON_CMD=y
CONFIG_DISTRO_DEFAULTS=y
CONFIG_USE_PREBOOT=y
CONFIG_SILENT_CONSOLE=y
CONFIG_SYS_PROMPT="n2awifi # "
CONFIG_CMD_BOOTMENU=y
CONFIG_CMD_I2C=y
CONFIG_CMD_MMC=y
CONFIG_ENV_OVERWRITE=y
CONFIG_NO_NET=y
CONFIG_BLKMAP=y
CONFIG_BUTTON=y
CONFIG_BUTTON_REMAP_PHONE_KEYS=y
CONFIG_SYS_I2C_S3C24X0=y
CONFIG_BUTTON_KEYBOARD=y
CONFIG_SUPPORT_EMMC_BOOT=y
CONFIG_MMC_DW=y
CONFIG_MMC_SDHCI=y
CONFIG_MMC_SDHCI_S5P=y
CONFIG_VIDEO=y
CONFIG_NO_FB_CLEAR=y
CONFIG_VIDEO_SIMPLE=y
CONFIG_VIDEO_DT_SIMPLEFB=y
CONFIG_EXT4_WRITE=y
```

## configs/v1a_wifi_defconfig
```kconfig
CONFIG_ARM=y
CONFIG_ARCH_CPU_INIT=y
CONFIG_ARCH_EXYNOS=y
CONFIG_TEXT_BASE=0x20008000
CONFIG_SYS_MALLOC_LEN=0x5004000
CONFIG_SYS_MALLOC_F_LEN=0x400
CONFIG_ARCH_EXYNOS5=y
CONFIG_TARGET_V1A_WIFI=y
CONFIG_NR_DRAM_BANKS=6
CONFIG_SF_DEFAULT_SPEED=50000000
CONFIG_ENV_SIZE=0x4000
CONFIG_DEFAULT_DEVICE_TREE="exynos5420-v1a-wifi"
CONFIG_SYS_LOAD_ADDR=0x20008000
CONFIG_IDENT_STRING=" for v1a-wifi"
CONFIG_SYS_MEM_TOP_HIDE=0x600000
CONFIG_FIT=y
CONFIG_FIT_BEST_MATCH=y
CONFIG_DISTRO_DEFAULTS=y
CONFIG_SILENT_CONSOLE=y
CONFIG_SYS_CONSOLE_IS_IN_ENV=y
CONFIG_CYCLIC=y
CONFIG_SYS_PROMPT="v1a-wifi # "
CONFIG_CMD_GPIO=y
CONFIG_CMD_I2C=y
CONFIG_CMD_MMC=y
CONFIG_CMD_SPI=y
# CONFIG_CMD_SETEXPR is not set
CONFIG_CMD_CACHE=y
CONFIG_CMD_TIME=y
CONFIG_CMD_PMIC=y
CONFIG_CMD_REGULATOR=y
CONFIG_CMD_EXT4_WRITE=y
CONFIG_ENV_OVERWRITE=y
CONFIG_SYS_I2C_S3C24X0=y
CONFIG_SUPPORT_EMMC_BOOT=y
CONFIG_MMC_DW=y
CONFIG_MMC_SDHCI=y
CONFIG_MMC_SDHCI_S5P=y
# CONFIG_SPI_FLASH is not set
CONFIG_DM_PMIC=y
CONFIG_DM_REGULATOR=y
CONFIG_DM_PWM=y
CONFIG_PWM_EXYNOS=y
CONFIG_EXYNOS_SPI=y
CONFIG_ERRNO_STR=y
```
